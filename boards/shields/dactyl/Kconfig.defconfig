## boards/shields/dactyl/Kconfig.defconfig
```kconfig
if SHIELD_DACTYL_DONGLE

config ZMK_KEYBOARD_NAME
    default "DACTYL"

config ZMK_SPLIT_BLE_ROLE_CENTRAL
    default y

config ZMK_USB
    default y

endif

if SHIELD_DACTYL_DONGLE || SHIELD_DACTYL_LEFT || SHIELD_DACTYL_RIGHT

config ZMK_SPLIT
    default y

config ZMK_BLE 
    default y

endif
```
